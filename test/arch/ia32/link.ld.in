/*
 * SPDX-FileCopyrightText: (C) Alex Smith <alex@alex-smith.me.uk>
 * SPDX-License-Identifier: ISC
 */

/**
 * @file
 * @brief               IA32 test kernel linker script.
 */

#include <arch/page.h>

ENTRY(kmain)
OUTPUT_ARCH("i386")
OUTPUT_FORMAT("elf32-i386")

PHDRS {
    text PT_LOAD FILEHDR PHDRS FLAGS(5);    /* R_X - Code + read-only data. */
    data PT_LOAD FLAGS(6);                  /* RW_ - Data. */
    note PT_NOTE FLAGS(0);
}

SECTIONS {
    /DISCARD/ : {
        *(.note.GNU-stack)
        *(.note.gnu.*)
        *(.comment*)
    }

    . = 0xc0000000;
    __text_seg_start = .;

    . = . + SIZEOF_HEADERS;
    .text : {
        __text_start = .;
        *(.text)
        *(.text.*)
        . = ALIGN(PAGE_SIZE);
        __text_end = .;
    } :text

    .notes : {
        *(.note.*)
    } :text :note

    . = ALIGN(PAGE_SIZE);
    .rodata : {
        __rodata_start = .;
        *(.rodata)
        *(.rodata.*)
        . = ALIGN(PAGE_SIZE);
        __rodata_end = .;
    } :text

    __text_seg_end = .;

    . = ALIGN(PAGE_SIZE);
    __data_seg_start = .;

    .data : {
        __data_start = .;
        *(.data)
        *(.data.*)
        . = ALIGN(PAGE_SIZE);
        __data_end = .;
    } :data

    . = ALIGN(PAGE_SIZE);
    .bss : {
        __bss_start = .;
        *(.bss)
        *(.bss.*)
        *(COMMON)
        . = ALIGN(PAGE_SIZE);
        __bss_end = .;
    } :data

    __data_seg_end = .;
    __end = .;
}
